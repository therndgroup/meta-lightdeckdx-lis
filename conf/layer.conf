## conf/layer.conf
```bitbake
BBPATH .= ":${LAYERDIR}"

BBFILES += "${LAYERDIR}/recipes-lightdeckdx-lis/*.bb"

BBFILE_COLLECTIONS += "lis"
BBFILE_PATTERN_lis := "^${LAYERDIR}/"

LAYERSERIES_COMPAT_lis = " gatesgarth"
```
